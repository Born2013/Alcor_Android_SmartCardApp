## mx2150_code/bird/alps/kernel-3.18/drivers/misc/mediatek/gyroscope/bmi160_gyro_bird/Kconfig
```kconfig
config MTK_BMI160_GYRO_BIRD
        bool "BMI160_GYRO_BIRD for MediaTek package"
        default n
        help
        It support different gyroscope sensor.
        If this option is set,
	  	it will support
         BMI160_GYRO_BIRD gyroscope.
```

## mx2150_code/bird/alps/kernel-3.18/drivers/misc/mediatek/lens/Kconfig
```kconfig
config MTK_LENS
  bool CONFIG_MTK_LENS
  default n
  help
    CONFIG_MTK_LENS

config MTK_LENS_USE_MODULE
  bool "Mediatek lens driver build as module"
  default n
  help
    Say Y here if you want to build touch driver as xxx.ko.

    If unsure, say N.

    To compile this dirver as a module,
    It will be called by insmod xxx.ko in init.rc.

#
# LENS
#

config MTK_LENS_DUMMYLENS_SUPPORT
  bool "Dummy Lens Driver"
  default n
  help
    Dummy Lens Driver
    This config is used to enable the corresponding
    lens driver for the camera sensor module
    Set as y if the driver is used in this project

config MTK_LENS_BU63165AF_SUPPORT
  bool "BU63165AF Lens Driver"
  default n
  help
    BU63165AF Lens Driver
    This config is used to enable the corresponding
    lens driver for the camera sensor module
    Set as y if the driver is used in this project

config MTK_LENS_AD5820AF_SUPPORT
  bool "AD5820AF Lens Driver"
  default n
  help
    AD5820AF Lens Driver
    This config is used to enable the corresponding
    lens driver for the camera sensor module
    Set as y if the driver is used in this project

config MTK_LENS_AD5823_SUPPORT
  bool "AD5823 Lens Driver"
  default n
  help
    AD5823 Lens Driver
    This config is used to enable the corresponding
    lens driver for the camera sensor module
    Set as y if the driver is used in this project

config MTK_LENS_AD5823AF_SUPPORT
  bool "AD5823AF Lens Driver"
  default n
  help
    AD5823AF Lens Driver
    This config is used to enable the corresponding
    lens driver for the camera sensor module
    Set as y if the driver is used in this project

config MTK_LENS_AK7345AF_SUPPORT
  bool "AK7345AF Lens Driver"
  default n
  help
    AK7345AF Lens Driver
    This config is used to enable the corresponding
    lens driver for the camera sensor module
    Set as y if the driver is used in this project

config MTK_LENS_AK7371AF_SUPPORT
  bool "AK7371AF Lens Driver"
  default n
  help
    AK7371AF Lens Driver
    This config is used to enable the corresponding
    lens driver for the camera sensor module
    Set as y if the driver is used in this project

config MTK_LENS_BU6424AF_SUPPORT
  bool "BU6424AF Lens Driver"
  default n
  help
    BU6424AF Lens Driver
    This config is used to enable the corresponding
    lens driver for the camera sensor module
    Set as y if the driver is used in this project

config MTK_LENS_BU6429AF_SUPPORT
  bool "BU6429AF Lens Driver"
  default n
  help
    BU6429AF Lens Driver
    This config is used to enable the corresponding
    lens driver for the camera sensor module
    Set as y if the driver is used in this project

config MTK_LENS_BU64745GWZAF_SUPPORT
  bool "BU64745GWZAF Lens Driver"
  default n
  help
    BU64745GWZAF Lens Driver
    This config is used to enable the corresponding
    lens driver for the camera sensor module
    Set as y if the driver is used in this project

config MTK_LENS_AK7345AF_SUPPORT
  bool "AK7345AF Lens Driver"
  default n
  help
    AK7345AF Lens Driver
    This config is used to enable the corresponding
    lens driver for the camera sensor module
    Set as y if the driver is used in this project

config MTK_LENS_DW9719TAF_SUPPORT
  bool "DW9719TAF Lens Driver"
  default n
  help
    DW9719TAF Lens Driver
    This config is used to enable the corresponding
    lens driver for the camera sensor module
    Set as y if the driver is used in this project

config MTK_LENS_DW9718AF_SUPPORT
  bool "DW9718AF Lens Driver"
  default n
  help
    DW9718AF Lens Driver
    This config is used to enable the corresponding
    lens driver for the camera sensor module
    Set as y if the driver is used in this project

config MTK_LENS_DW9714AF_SUPPORT
  bool "DW9714AF Lens Driver"
  default n
  help
    DW9714AF Lens Driver
    This config is used to enable the corresponding
    lens driver for the camera sensor module
    Set as y if the driver is used in this project

config MTK_LENS_DW9714A_SUPPORT
  bool "DW9714A Lens Driver"
  default n
  help
    DW9714A Lens Driver
    This config is used to enable the corresponding
    lens driver for the camera sensor module
    Set as y if the driver is used in this project

config MTK_LENS_DW9814AF_SUPPORT
  bool "DW9814AF Lens Driver"
  default n
  help
    DW9814AF Lens Driver
    This config is used to enable the corresponding
    lens driver for the camera sensor module
    Set as y if the driver is used in this project

config MTK_LENS_LC898122AF_SUPPORT
  bool "LC898122AF Lens Driver"
  default n
  help
    LC898122AF Lens Driver
    This config is used to enable the corresponding
    lens driver for the camera sensor module
    Set as y if the driver is used in this project

config MTK_LENS_LC898212AF_SUPPORT
  bool "LC898212AF Lens Driver"
  default n
  help
    LC898212AF Lens Driver
    This config is used to enable the corresponding
    lens driver for the camera sensor module
    Set as y if the driver is used in this project

config MTK_LENS_LC898212XDAF_SUPPORT
  bool "LC898212XDAF Lens Driver"
  default n
  help
    LC898212XDAF Lens Driver
    This config is used to enable the corresponding
    lens driver for the camera sensor module
    Set as y if the driver is used in this project

config MTK_LENS_LC898214AF_SUPPORT
  bool "LC898214AF Lens Driver"
  default n
  help
    LC898212AF Lens Driver
    This config is used to enable the corresponding
    lens driver for the camera sensor module
    Set as y if the driver is used in this project

config MTK_LENS_FM50AF_SUPPORT
  bool "FM50AF Lens Driver"
  default n
  help
    FM50AF Lens Driver
    This config is used to enable the corresponding
    lens driver for the camera sensor module
    Set as y if the driver is used in this project

config MTK_LENS_MT9P017AF_SUPPORT
  bool "MT9P017AF Lens Driver"
  default n
  help
    MT9P017AF Lens Driver
    This config is used to enable the corresponding
    lens driver for the camera sensor module
    Set as y if the driver is used in this project

config MTK_LENS_OV8825AF_SUPPORT
  bool "OV8825AF Lens Driver"
  default n
  help
    OV8825AF Lens Driver
    This config is used to enable the corresponding
    lens driver for the camera sensor module
    Set as y if the driver is used in this project

config MTK_LENS_SENSORDRIVE_SUPPORT
  bool "SENSORDRIVE Lens Driver"
  default n
  help
    SENSORDRIVE Lens Driver
    This config is used to enable the corresponding
    lens driver for the camera sensor module
    Set as y if the driver is used in this project

config MTK_LENS_GAF001AF_SUPPORT
  bool "GAF001AF Lens Driver"
  default n
  help
    GAF001AF Lens Driver
    This config is used to enable the corresponding
    lens driver for the camera sensor module
    Set as y if the driver is used in this project

config MTK_LENS_GAF002AF_SUPPORT
  bool "GAF002AF Lens Driver"
  default n
  help
    GAF002AF Lens Driver
    This config is used to enable the corresponding
    lens driver for the camera sensor module
    Set as y if the driver is used in this project

config MTK_LENS_GAF008AF_SUPPORT
  bool "GAF008AF Lens Driver"
  default n
  help
    GAF008AF Lens Driver
    This config is used to enable the corresponding
    lens driver for the camera sensor module
    Set as y if the driver is used in this project

config MTK_LENS_WV511AAF_SUPPORT
  bool "WV511AAF Lens Driver"
  default n
  help
    WV511AAF Lens Driver
    This config is used to enable the corresponding
    lens driver for the camera sensor module
    Set as y if the driver is used in this project

#BIRD BEGIN
config MTK_LENS_IMX219AF_SUPPORT
  bool "IMX219AF Lens Driver"
  default n
  help
    IMX219AF Lens Driver
    This config is used to enable the corresponding
    lens driver for the camera sensor module
    Set as y if the driver is used in this project

config MTK_LENS_IMX214AF_SUPPORT
  bool "IMX214AF Lens Driver"
  default n
  help
    IMX214AF Lens Driver
    This config is used to enable the corresponding
    lens driver for the camera sensor module
    Set as y if the driver is used in this project

config MTK_LENS_IMX149AF_SUPPORT
  bool "IMX149AF Lens Driver"
  default n
  help
    IMX149AF Lens Driver
    This config is used to enable the corresponding
    lens driver for the camera sensor module
    Set as y if the driver is used in this project

config MTK_LENS_OV13850AF_SUPPORT
  bool "OV13850AF Lens Driver"
  default n
  help
    OV13850AF Lens Driver
    This config is used to enable the corresponding
    lens driver for the camera sensor module
    Set as y if the driver is used in this project

config MTK_LENS_OV8858AF_SUPPORT
  bool "OV8858AF Lens Driver"
  default n
  help
    OV8858AF Lens Driver
    This config is used to enable the corresponding
    lens driver for the camera sensor module
    Set as y if the driver is used in this project
config MTK_LENS_OV8856AF_SUPPORT
  bool "OV8856AF Lens Driver"
  default n
  help
    OV8856AF Lens Driver
    This config is used to enable the corresponding
    lens driver for the camera sensor module
    Set as y if the driver is used in this project

config MTK_LENS_OV5695AF_SUPPORT
  bool "OV5695AF Lens Driver"
  default n
  help
    OV5695AF Lens Driver
    This config is used to enable the corresponding
    lens driver for the camera sensor module
    Set as y if the driver is used in this project
    
    config MTK_LENS_OV5647AF_SUPPORT
  bool "OV5647AF Lens Driver"
  default n
  help
    OV5647AF Lens Driver
    This config is used to enable the corresponding
    lens driver for the camera sensor module
    Set as y if the driver is used in this project
    
  config MTK_LENS_OV5647AAF_SUPPORT
  bool "OV5647AAF Lens Driver"
  default n
  help
    OV5647AAF Lens Driver
    This config is used to enable the corresponding
    lens driver for the camera sensor module
    Set as y if the driver is used in this project

config MTK_LENS_GC8034AF_SUPPORT
  bool "GC8034AF Lens Driver"
  default n
  help
    GC8034AF Lens Driver
    This config is used to enable the corresponding
    lens driver for the camera sensor module
    Set as y if the driver is used in this project

config MTK_LENS_GC8024AF_SUPPORT
  bool "GC8024AF Lens Driver"
  default n
  help
    GC8024AF Lens Driver
    This config is used to enable the corresponding
    lens driver for the camera sensor module
    Set as y if the driver is used in this project

config MTK_LENS_IMX258AF_SUPPORT
  bool "IMX258AF Lens Driver"
  default n
  help
    IMX258AF Lens Driver
    This config is used to enable the corresponding
    lens driver for the camera sensor module
    Set as y if the driver is used in this project

config MTK_LENS_GC5024AF_SUPPORT
  bool "GC5024AF Lens Driver"
  default n
  help
    GC5024AF Lens Driver
    This config is used to enable the corresponding
    lens driver for the camera sensor module
    Set as y if the driver is used in this project

config MTK_LENS_GC5005AF_SUPPORT
  bool "GC5005AF Lens Driver"
  default n
  help
    GC5005AF Lens Driver
    This config is used to enable the corresponding
    lens driver for the camera sensor module
    Set as y if the driver is used in this project

config MTK_LENS_GC5025AF_SUPPORT
  bool "GC5025AF Lens Driver"
  default n
  help
    GC5025AF Lens Driver
    This config is used to enable the corresponding
    lens driver for the camera sensor module
    Set as y if the driver is used in this project

config MTK_LENS_OV8858AF_SUPPORT
  bool "OV8858AF Lens Driver"
  default n
  help
    OV8858AF Lens Driver
    This config is used to enable the corresponding
    lens driver for the camera sensor module
    Set as y if the driver is used in this project

config MTK_LENS_OV8865AF_SUPPORT
  bool "OV8865AF Lens Driver"
  default n
  help
    OV8865AF Lens Driver
    This config is used to enable the corresponding
    lens driver for the camera sensor module
    Set as y if the driver is used in this project

config MTK_LENS_S5K3L8AF_SUPPORT
  bool "S5K3L8AF Lens Driver"
  default n
  help
    S5K3L8AF Lens Driver
    This config is used to enable the corresponding
    lens driver for the camera sensor module
    Set as y if the driver is used in this project

config MTK_LENS_SP5506AF_SUPPORT
  bool "SP5506AF Lens Driver"
  default n
  help
    SP5506AF Lens Driver
    This config is used to enable the corresponding
    lens driver for the camera sensor module
    Set as y if the driver is used in this project

config MTK_LENS_S5K5E2YAAF_SUPPORT
  bool "S5K5E2YAAF Lens Driver"
  default n
  help
    S5K5E2YAAF Lens Driver
    This config is used to enable the corresponding
    lens driver for the camera sensor module
    Set as y if the driver is used in this project

config MTK_LENS_S5K3M2AF_SUPPORT
  bool "S5K3M2AF Lens Driver"
  default n
  help
    S5K3M2AF Lens Driver
    This config is used to enable the corresponding
    lens driver for the camera sensor module
    Set as y if the driver is used in this project
    
config MTK_LENS_BF2507AF_SUPPORT
  bool "BF2507AF Lens Driver"
  default n
  help
    BF2507AF Lens Driver
    This config is used to enable the corresponding
    lens driver for the camera sensor module
    Set as y if the driver is used in this project

config MTK_LENS_AR0543AF_SUPPORT
  bool "AR0543AF Lens Driver"
  default n
  help
    AR0543AF Lens Driver
    This config is used to enable the corresponding
    lens driver for the camera sensor module
    Set as y if the driver is used in this project

config MTK_LENS_S5K4H8AF_SUPPORT
  bool "S5K4H8AF Lens Driver"
  default n
  help
    S5K4H8AF Lens Driver
    This config is used to enable the corresponding
    lens driver for the camera sensor module
    Set as y if the driver is used in this project

#BIRD END
  
```

## mx2150_code/bird/alps/kernel-3.18/drivers/misc/mediatek/magnetometer/mmc3630/Kconfig
```kconfig
config MTK_MMC3630
	bool "MMC3630 for MediaTek package"
	default n
	help
	  It support different magnetometer sensor.
          If this option is set,
	  it will support
          MMC3630 magnetometer.
```

## mx2150_code/bird/alps/kernel-3.18/drivers/misc/mediatek/microarray_new/Kconfig
```kconfig
#
#Fingerprint
#


config MICROARRAY_FINGERPRINT_NEW
	tristate "MICROARRAY Fingerprint new driver"
	default n
	---help---
	Fingerprint mtk driver enable/disable in the kernel.
	Say Y here if you want to use mediatek fingerprint driver,
	fingerprint driver will support fingerprint function in REE,
	it supports MICROARRAY's 
```

## mx2150_code/bird/alps/kernel-3.18/drivers/misc/mediatek/sunwavecorp/Kconfig
```kconfig
#
#Fingerprint
#


config SUNWAVECORP_FINGERPRINT
	tristate "sunwavecorp Fingerprint"
	default n
	---help---
	Fingerprint mtk driver enable/disable in the kernel.
	Say Y here if you want to use mediatek fingerprint driver,
	fingerprint driver will support fingerprint function in REE,
	it supports sunwavecorp's 
```
