## cardreader_bird/Kconfig
```kconfig
config BIRD_CARDREADER_SUPPORT
  bool "BIRD_CARDREADER_SUPPORT Driver"
  default n
  help
    BIRD_CARDREADER_SUPPORT

config BIRD_CARDREADER_SUPPORT_FOR_MX2150P_V01_UART
  bool "BIRD_CARDREADER_SUPPORT_FOR_MX2150P_V01_UART Driver"
  default n
  help
    BIRD_CARDREADER_SUPPORT IF FOR MX2150P V01 3V3
```

## mx2150_code/bird/alps/kernel-3.18/drivers/input/touchscreen/mediatek/GT1XX/Kconfig
```kconfig
#
# Touchscreen driver configuration
#

if TOUCHSCREEN_MTK_GT1XX


config GT1XX_FIRMWARE
	string "GT1XX for Mediatek firmware"


config GT1XX_CONFIG
	string "GT1XX for Mediatek config"





endif
```

## mx2150_code/bird/alps/kernel-3.18/drivers/input/touchscreen/mediatek/GT56XX_BIRD_C/Kconfig
```kconfig
#
# Touchscreen driver configuration
#
if TOUCHSCREEN_MTK_GT56XX_BIRD_C

config GT56XX_BIRD_C_FIRMWARE
	string "GT56XX_BIRD_C GT56XX_BIRD_C_FIRMWARE"

config GT56XX_BIRD_C_CONFIG
	string "GT56XX_BIRD_C GT56XX_BIRD_C_CONFIG"

config GTP_DRIVER_SEND_CFG
	bool "GT56XX_BIRD_C GTP_DRIVER_SEND_CFG"
	default n
	help
	Say Y here if you have GT56XX_BIRD_C touch panel GTP_DRIVER_SEND_CFG.

	If unsure, say N.

	To compile this dirver as a module, choose M here: the
	module will be called.

config GTP_CUSTOM_CFG
	bool "GT56XX_BIRD_C GTP_CUSTOM_CFG"
	default n
	help
	Say Y here if you have GT56XX_BIRD_C touch panel GTP_CUSTOM_CFG.

	If unsure, say N.

	To compile this dirver as a module, choose M here: the
	module will be called.

config GTP_CHANGE_X2Y
	bool "GT56XX_BIRD_C GTP_CHANGE_X2Y"
	default n
	help
	Say Y here if you have GT56XX_BIRD_C touch panel GTP_CHANGE_X2Y.

	If unsure, say N.

	To compile this dirver as a module, choose M here: the
	module will be called.

config GTP_WARP_X_ON
	bool "GT56XX_BIRD_C GTP_WARP_X_ON"
	default n
	help
	Say Y here if you have GT56XX_BIRD_C touch panel GTP_WARP_X_ON.

	If unsure, say N.

	To compile this dirver as a module, choose M here: the
	module will be called.

config GTP_WARP_Y_ON
	bool "GT56XX_BIRD_C GTP_WARP_Y_ON"
	default n
	help
	Say Y here if you have GT56XX_BIRD_C touch panel GTP_WARP_Y_ON.

	If unsure, say N.

	To compile this dirver as a module, choose M here: the
	module will be called.

config GTP_GESTURE_WAKEUP
	bool "GT56XX_BIRD_C GTP_GESTURE_WAKEUP"
	default n
	help
	Say Y here if you have GT56XX_BIRD_C touch panel GTP_GESTURE_WAKEUP.

	If unsure, say N.

	To compile this dirver as a module, choose M here: the
	module will be called.

config GTP_GESTURE_DOUBLE_CLICK_WAKEUP
	bool "GT56XX_BIRD_C GTP_GESTURE_DOUBLE_CLICK_WAKEUP"
	default n
	help
	Say Y here if you have GT56XX_BIRD_C touch panel GTP_GESTURE_DOUBLE_CLICK_WAKEUP.

	If unsure, say N.

	To compile this dirver as a module, choose M here: the
	module will be called.

config GTP_HOTKNOT
	bool "GT56XX_BIRD_C GTP_HOTKNOT"
	default n
	help
	Say Y here if you have GT56XX_BIRD_C touch panel GTP_HOTKNOT.

	If unsure, say N.

	To compile this dirver as a module, choose M here: the
	module will be called.

config HOTKNOT_TYPE
	bool "GT56XX_BIRD_C HOTKNOT_TYPE"
	default n
	help
	Say Y here if you have GT56XX_BIRD_C touch panel HOTKNOT_TYPE.

	If unsure, say N.

	To compile this dirver as a module, choose M here: the
	module will be called.

config HOTKNOT_BLOCK_RW
	bool "GT56XX_BIRD_C HOTKNOT_BLOCK_RW"
	default n
	help
	Say Y here if you have GT56XX_BIRD_C touch panel HOTKNOT_BLOCK_RW.

	If unsure, say N.

	To compile this dirver as a module, choose M here: the
	module will be called.

config GTP_PROXIMITY
	bool "GT56XX_BIRD_C GTP_PROXIMITY"
	default n
	help
	Say Y here if you have GT56XX_BIRD_C touch panel GTP_PROXIMITY.

	If unsure, say N.

	To compile this dirver as a module, choose M here: the
	module will be called.

config GTP_WITH_STYLUS
	bool "GT56XX_BIRD_C GTP_WITH_STYLUS"
	default n
	help
	Say Y here if you have GT56XX_BIRD_C touch panel GTP_WITH_STYLUS.

	If unsure, say N.

	To compile this dirver as a module, choose M here: the
	module will be called.

config GTP_HAVE_STYLUS_KEY
	bool "GT56XX_BIRD_C GTP_HAVE_STYLUS_KEY"
	default n
	help
	Say Y here if you have GT56XX_BIRD_C touch panel GTP_HAVE_STYLUS_KEY.

	If unsure, say N.

	To compile this dirver as a module, choose M here: the
	module will be called.

config GTP_AUTO_UPDATE
	bool "GT56XX_BIRD_C GTP_AUTO_UPDATE"
	default n
	help
	Say Y here if you have GT56XX_BIRD_C touch panel GTP_AUTO_UPDATE.

	If unsure, say N.

	To compile this dirver as a module, choose M here: the
	module will be called.

config GTP_HEADER_FW_UPDATE
	bool "GT56XX_BIRD_C GTP_HEADER_FW_UPDATE"
	default n
	help
	Say Y here if you have GT56XX_BIRD_C touch panel GTP_HEADER_FW_UPDATE.

	If unsure, say N.

	To compile this dirver as a module, choose M here: the
	module will be called.

config GTP_CREATE_WR_NODE
	bool "GT56XX_BIRD_C GTP_CREATE_WR_NODE"
	default n
	help
	Say Y here if you have GT56XX_BIRD_C touch panel GTP_CREATE_WR_NODE.

	If unsure, say N.

	To compile this dirver as a module, choose M here: the
	module will be called.

config GTP_ESD_PROTECT
	bool "GT56XX_BIRD_C GTP_ESD_PROTECT"
	default n
	help
	Say Y here if you have GT56XX_BIRD_C touch panel GTP_ESD_PROTECT.

	If unsure, say N.

	To compile this dirver as a module, choose M here: the
	module will be called.

config GTP_CHARGER_SWITCH
	bool "GT56XX_BIRD_C GTP_CHARGER_SWITCH"
	default n
	help
	Say Y here if you have GT56XX_BIRD_C touch panel GTP_CHARGER_SWITCH.

	If unsure, say N.

	To compile this dirver as a module, choose M here: the
	module will be called.

config GTP_DEBUG_ARRAY_ON
	bool "GT56XX_BIRD_C GTP_DEBUG_ARRAY_ON"
	default n
	help
	Say Y here if you have GT56XX_BIRD_C touch panel GTP_DEBUG_ARRAY_ON.

	If unsure, say N.

	To compile this dirver as a module, choose M here: the
	module will be called.

config GTP_DEBUG_FUNC_ON
	bool "GT56XX_BIRD_C GTP_DEBUG_FUNC_ON"
	default n
	help
	Say Y here if you have GT56XX_BIRD_C touch panel GTP_DEBUG_FUNC_ON.

	If unsure, say N.

	To compile this dirver as a module, choose M here: the
	module will be called.

config GTP_POWER_CTRL_SLEEP
	bool "GT56XX_BIRD_C GTP_POWER_CTRL_SLEEP"
	default n
	help
	Say Y here if you have GT56XX_BIRD_C touch panel GTP_POWER_CTRL_SLEEP.

	If unsure, say N.

	To compile this dirver as a module, choose M here: the
	module will be called.

config BIRD_TPD_POWER_USER_VGP1
	bool "GT56XX_BIRD_C BIRD_TPD_POWER_USER_VGP1"
	default n
	help
	Say Y here if you use VTP28 of VGP1 voltage for touch panel.


config BIRD_TPD_POWER_USER_VGP1_MX2103FD
	bool "GT56XX_BIRD_C BIRD_TPD_POWER_USER_VGP1_MX2103FD"
	default n
	help
	Say Y here if you use VTP28 of VGP1 MX2103FD voltage for touch panel.

config GTP_CANCEL_FIXED_VERSION
	bool "GT56XX_BIRD_C GTP_CANCEL_FIXED_VERSION"
	default n
	help
	If you want to cancel fixed ctp version, you can make it.

config GTP_MX2135F_E5505_VERSION
	bool "GT56XX_BIRD_C GTP_MX2135F_E5505_VERSION"
	default n
	help
	Only MX2135F_E5505_EU23 use.

config GTP_MX2135F_RHTX_HL51
	bool "GT56XX_BIRD_C GTP_MX2135F_RHTX_HL51"
	default n
	help
	Only MX2135F_E5505_EU23 use.



endif
```

## mx2150_code/bird/alps/kernel-3.18/drivers/input/touchscreen/mediatek/focaltech_BIRD_C/Kconfig
```kconfig
#
# Touchscreen driver configuration
#
if TOUCHSCREEN_MTK_FOCALTECH_BIRD_C

config FT5X0X_FIRMWARE
	string "FT5X0X for Mediatek firmware"

config TPD_ROTATE_90
	bool "TPD_ROTATE_90"
	default n
	help
	Say Y here if you have ft5x0x touch panel TPD_ROTATE_90.

	If unsure, say N.

	To compile this dirver as a module, choose M here: the
	module will be called.

config TPD_ROTATE_180
	bool "TPD_ROTATE_180"
	default n
	help
	Say Y here if you have ft5x0x touch panel TPD_ROTATE_180.

	If unsure, say N.

	To compile this dirver as a module, choose M here: the
	module will be called.

config TPD_ROTATE_270
	bool "TPD_ROTATE_270"
	default n
	help
	Say Y here if you have ft5x0x touch panel TPD_ROTATE_270.

	If unsure, say N.

	To compile this dirver as a module, choose M here: the
	module will be called.

config FT_AUTO_UPGRADE_SUPPORT
	bool "FT_AUTO_UPGRADE_SUPPORT"
	default y
	help
	Say Y here if you have ft5x0x touch panel FT_AUTO_UPGRADE_SUPPORT.

	If unsure, say N.

	To compile this dirver as a module, choose M here: the
	module will be called.

config CUST_FTS_APK_DEBUG
	bool "CUST_FTS_APK_DEBUG"
	default y
	help
	Say Y here if you have ft5x0x touch panel CUST_FTS_APK_DEBUG.

	If unsure, say N.

	To compile this dirver as a module, choose M here: the
	module will be called.

config TPD_HAVE_CALIBRATION
	bool "TPD_HAVE_CALIBRATION"
	default n
	help
	Say Y here if you have ft5x0x touch panel TPD_HAVE_CALIBRATION.

	If unsure, say N.

	To compile this dirver as a module, choose M here: the
	module will be called.

config TPD_CUSTOM_CALIBRATION
	bool "TPD_CUSTOM_CALIBRATION"
	default n
	help
	Say Y here if you have ft5x0x touch panel TPD_CUSTOM_CALIBRATION.

	If unsure, say N.

	To compile this dirver as a module, choose M here: the
	module will be called.

config BIRD_FOCALTECH_PARAM
	string "BIRD_FOCALTECH_PARAM"
	help
	  Add FOCALTECH PARAM ...

endif
```

## mx2150_code/bird/alps/kernel-3.18/drivers/input/touchscreen/mediatek/msg2133_update/Kconfig
```kconfig
#
# Touchscreen driver configuration
#
if TOUCHSCREEN_MTK_MSG2133_UPDATE
	

config  TPD_COMPATIBILITY_REPORT_KEY
	bool "TPD_COMPATIBILITY_REPORT_KEY"
	default n
	help
	Say Y here if you use msg2133 and compatibility other IC, msg2133 report key use g_TpVirtualKey instead of using dts.


config  BIRD_MSG2XXX_CTP_TSFW
	string "BIRD_MSG2XXX_CTP_TSFW Config"
	---help---
	  This selects the MSG2133_UPDATE driver.


config  TPD_POWER_VTP28_USE_VCAMA
	bool "TPD_POWER_VTP28_USE_VCAMA"
	default n
	help
	Say Y here if you use VTP28 of VCAMA voltage for touch panel.



endif
```

## mx2150_code/bird/alps/kernel-3.18/drivers/misc/mediatek/accelerometer/bma220-new/Kconfig
```kconfig
config MTK_BMA220_NEW
	bool "MTK_BMA220_NEW for MediaTek package"
	default n
	help
	  It support different accelerometer sensor.
          If this option is set,
	  it will support
          MTK_BMA220_NEW Accelerometer.
```

## mx2150_code/bird/alps/kernel-3.18/drivers/misc/mediatek/accelerometer/bmi160_acc_bird/Kconfig
```kconfig
config MTK_BMI160_ACC_BIRD
	bool "BMI160_ACC_BIRD_ACC for MediaTek package"
	default n
	help
	  It support different accelerometer sensor.
          If this option is set,
	  it will support
          BMI160_ACC_BIRD Accelerometer.
```

## mx2150_code/bird/alps/kernel-3.18/drivers/misc/mediatek/accelerometer/mxc400x_bird_c/Kconfig
```kconfig
config MTK_MXC400X_BIRD_C
	bool "MXC400X_BIRD_C for MediaTek package"
	default n
	help
	  It support different accelerometer sensor.
          If this option is set,
	  it will support
          MXC400X_BIRD_C Accelerometer.
```

## mx2150_code/bird/alps/kernel-3.18/drivers/misc/mediatek/accelerometer/sc7a20_bird/Kconfig
```kconfig
config MTK_SC7A20_BIRD
	tristate "SC7A20 for MediaTek package"
	default n
	help
	  It support different accelerometer sensor.
          If this option is set,
	  it will support
          SC7A20 Accelerometer.
```

## mx2150_code/bird/alps/kernel-3.18/drivers/misc/mediatek/alsps/scm_0147b_bird_c/Kconfig
```kconfig
config MTK_SCM_0147B_BIRD_C
	bool "SCM_0147B_BIRD_C for MediaTek package"
	default n
	help
	It support different type sensor
	in this platform. If this option
	is set, it will support ambient
	and light sensor SCM_0147B_BIRD_C.
```

## mx2150_code/bird/alps/kernel-3.18/drivers/misc/mediatek/alsps/stk3x1x_bird_c/Kconfig
```kconfig
config MTK_STK3X1X_BIRD_C
	bool "stk3x1x for MediaTek package"
	default n
	help
	It support different type sensor
	in this platform. If this option
	is set, it will support ambient
	and light sensor STK3X1X.

config  BIRD_STK3X1X_BIRD_C_PRAMS
	string "STK3X1X_BIRD_C_PRAMS"
	depends on  MTK_STK3X1X_BIRD_C
	---help---
	  This selects the STK3X1X_BIRD_C  driver.
```

## mx2150_code/bird/alps/kernel-3.18/drivers/misc/mediatek/am2120u_wt_bird/Kconfig
```kconfig
config BIRD_WALKIE_TALKIES_AM2120U_SUPPORT
  bool "BIRD WALKIE TALKIES AM2120U Driver"
  default n
  help
    BIRD_WALKIE_TALKIES_AM2120U Driver
```

## mx2150_code/bird/alps/kernel-3.18/drivers/misc/mediatek/betterlife5192/Kconfig
```kconfig
#
#Fingerprint
#


config BLESTECH_FINGERPRINT
	tristate "BLESTECH_FINGERPRINT Fingerprint"
	default n
	---help---
	Fingerprint mtk driver enable/disable in the kernel.
	Say Y here if you want to use mediatek fingerprint driver,
```

## mx2150_code/bird/alps/kernel-3.18/drivers/misc/mediatek/birdhwinfo/Kconfig
```kconfig
config BIRD_HARDWARE_INFOMATION
  bool "BIRD_HARDWARE_INFOMATION Driver"
  default n
  help
    BIRD_HARDWARE_INFOMATION
```

## mx2150_code/bird/alps/kernel-3.18/drivers/misc/mediatek/breathled/Kconfig
```kconfig
config BIRD_BREATH_LED_SUPPORT
  bool "AW2013 BREATH_LED Driver"
  default n
  help
    BREATH_IC_AW2013 SUPPORT

config BIRD_BREATH_LED_SUPPORT_FOR_MX2151E
  bool "AW2013 BREATH_LED MX2151E Driver"
  default n
  help
    BREATH_IC_AW2013 SUPPORT MX2151E
```

## mx2150_code/bird/alps/kernel-3.18/drivers/misc/mediatek/camera_cover_bird/Kconfig
```kconfig
config BIRD_CAMERA_COVER_SUPPORT
  bool "DUAL CAMERA FOR ONE COVER Driver"
  default n
  help
    BIRD_CAMERA_COVER_SUPPORT Driver

config BIRD_CAMERA_COVER_SUPPORT_GC2145
  bool "DUAL CAMERA FOR ONE GC2145 ONLY FOR COVER Driver"
  depends on BIRD_CAMERA_COVER_SUPPORT
  default n
  help
    BIRD_CAMERA_COVER_SUPPORT_GC2145 Driver

config SHUTTER_MAPPING_VALUE
   int "SHUTTER_MAPPING_VALUE"
   depends on BIRD_CAMERA_COVER_SUPPORT
   default 4000
   help
     shutter value shoud modify base sensor that is used now

config BIRD_CAMERA_COVER_SUPPORT_ADD_GC2385
   bool "DUAL CAMERA FOR ONE COVER GC2385 Driver"
   depends on BIRD_CAMERA_COVER_SUPPORT
   default n
   help
     BIRD_CAMERA_COVER_SUPPORT GC2385Driver

config BIRD_CAMERA_COVER_SUPPORT_GC2145_FOR_SMT
  bool "DUAL CAMERA FOR ONE GC2145 ONLY FOR FOR_SMT COVER Driver"
  depends on BIRD_CAMERA_COVER_SUPPORT
  default n
  help
    BIRD_CAMERA_COVER_SUPPORT_GC2145_FOR_SMT Driver
```

## mx2150_code/bird/alps/kernel-3.18/drivers/misc/mediatek/cdfingerfp/Kconfig
```kconfig
config FINGERPRINT_CDFINGER_SUPPORT
  bool "FINGERPRINT FPS1098 Driver"
  default n
  help
    FINGERPRINT CDFINGER SUPPORT
```

## mx2150_code/bird/alps/kernel-3.18/drivers/misc/mediatek/et4003_bird/Kconfig
```kconfig
config BIRD_IR_REMOTE_ET4003_SUPPORT
  bool "BIRD IR REMOTE ET4003 SUPPORT Driver"
  default n
  help
    BIRD_IR_REMOTE_ET4003_SUPPORT Driver

config BIRD_IR_REMOTE_ET4003_SUPPORT_FOR_SMT
  bool "BIRD_IR_REMOTE_ET4003_SUPPORT_FOR_SMT Driver"
  depends on BIRD_IR_REMOTE_ET4003_SUPPORT
  default n
  help
    if open this , only for smt , not for mp

config BIRD_IR_REMOTE_ET4003_SUPPORT_FOR_MX2150E
  bool "BIRD_IR_REMOTE_ET4003_SUPPORT_FOR_MX2150 Driver"
  depends on BIRD_IR_REMOTE_ET4003_SUPPORT
  default n
  help
    if open this , only for smt , not for mp
```

## mx2150_code/bird/alps/kernel-3.18/drivers/misc/mediatek/flashlight/Kconfig
```kconfig
config MTK_FLASHLIGHT
  bool CONFIG_MTK_FLASHLIGHT
  default n
  help
    CONFIG_MTK_FLASHLIGHT

config CUSTOM_KERNEL_FLASHLIGHT
        string "CUSTOM_KERNEL_FLASHLIGHT"
        help
          Kernel space cameara flashlight driver. You can use this driver
          choose cameara flashlight type.

config MTK_FLASHLIGHT_USE_MODULE
	bool "Mediatek flashlight driver build as module"
	default n
	help
	  Say Y here if you want to build flashlight driver as xxx.ko.

	  If unsure, say N.

	  To compile this dirver as a module,
	  It will be called by insmod xxx.ko in init.rc.
	  
config DUAL_REAL_FLASHLIGHT
        bool DUAL_REAL_FLASHLIGHT
	depends on MTK_FLASHLIGHT
        help
          Kernel space cameara dual_real_flashlight driver. You can use this driver
          choose cameara dual_real_flashlight type.
	  
config CUSTOM_KERNEL_SUBFLASHLIGHT
	bool CONFIG_CUSTOM_KERNEL_SUBFLASHLIGHT
	default n
	help
	  Kernel space sub cameara flashlight driver. You can use this driver
          choose sub cameara flashlight type.
```
